## config/west.yml
```yaml
manifest:
  remotes:
    - name: zmkfirmware
      url-base: https://github.com/zmkfirmware
    - name: badjeff
      url-base: https://github.com/badjeff
    - name: caksoylar
      url-base: https://github.com/caksoylar
    - name: yamaryu211
      url-base: https://github.com/yamaryu211
  projects:
    - name: zmk
      remote: zmkfirmware
      revision: v0.3
      import: app/west.yml
    - name: zmk-pmw3610-driver
      remote: badjeff
      revision: zmk-0.3
    - name: zmk-rgbled-widget
      remote: caksoylar
      revision: v0.3-branch
    - name: zmk-input-processor-temp-layer-threshold
      remote: yamaryu211
      revision: main
  self:
    path: config
```
